
/**
 * Huawei Ltd.
 * PhosphorV660
 */


/include/ "fastboot.dtsi"
/include/ "DAVINCE_703L_01_config.dtsi"
/include/ "DAVINCE_703LC_02_pin.dtsi"
/include/ "DAVINCE_703LC_02_hi6402_pin.dtsi"
/include/ "DAVINCE_703LC_02_modem_pin.dtsi"
///include/ "DAVINCE_703LC_02_charger.dtsi"
///include/ "DAVINCE_703LC_02_pmic.dtsi"
///include/ "DAVINCE_703LC_02_gpio_logic.dtsi"

/ {
	hisi,boardid = <1 1 2 3 >;
	hisi,boardname = "DAVINCE_703LC_02";
	hisi,modem_id = <0x3E9E6880>;
	hisi,hardware_version="STENDAV703LCAPV0002";

};

