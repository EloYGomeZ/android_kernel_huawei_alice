
/**
 * Huawei Ltd.
 * PhosphorV660
 */

/dts-v1/;

/include/ "fastboot.dtsi"
/include/ "CARRERA_UL_V3_config.dtsi"
/include/ "CARRERA_UL_V3_66T_pin.dtsi"
/include/ "CARRERA_UL_V3_66T_hi6402_pin.dtsi"
/include/ "CARRERA_UL_V3_66T_modem_pin.dtsi"
///include/ "CARRERA_UL_V3_66T_charger.dtsi"
///include/ "CARRERA_UL_V3_66T_pmic.dtsi"
///include/ "CARRERA_UL_V3_66T_gpio_logic.dtsi"

/ {
	hisi,boardid = <1 4 8 2 >;
	hisi,boardname = "CARRERA_UL_V3_66T";
};

