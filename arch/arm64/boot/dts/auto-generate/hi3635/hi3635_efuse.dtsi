/*
 * Hisilicon Ltd. Hi3635 SoC
 *
 * Copyright (C) 2013-2014 Hisilicon Ltd.
 * Author         : l00265041
 *
 * This program is free software; you can redistribute it and/or modify
 * it under the terms of the GNU General Public License version 2 as
 * publishhed by the Free Software Foundation.
 */

/ {
    hisi_efuse: efuse {
        compatible = "hisilicon, efuse";
        efuse_mem_attr_group_max = <64>;
        efuse_mem_attr_huk = <256>;
        efuse_mem_attr_scp = <64>;
        efuse_mem_attr_authkey = <64>;
        efuse_mem_attr_chipid = <64>;
        efuse_mem_attr_tsensor_calibration = <32>;
        efuse_mem_attr_huk_rd_disable = <3>;
        efuse_mem_attr_authkey_rd_disable = <1>;        
        efuse_mem_attr_dbg_class_ctrl = <2>;
        efuse_mem_attr_dieid = <156>;
    };
};
